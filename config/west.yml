## config/west.yml
```yaml
manifest:
  remotes:
    - name: zmkfirmware
      url-base: https://github.com/zmkfirmware
    # - name: newx-it
    #   url-base: https://github.com/newx-it
  projects:
    - name: zmk
      # remote: newx-it
      # revision: feat-ble-prevent-sleep-feat-usb-allow-sleep
      remote: zmkfirmware
      revision: main
      import: app/west.yml
  self:
    path: config
```
